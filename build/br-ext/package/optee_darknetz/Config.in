## build/br-ext/package/optee_darknetz/Config.in
```kconfig
config BR2_PACKAGE_OPTEE_DARKNETZ
	bool "optee_darknetz"
	help
	  optee_darknetz project

if BR2_PACKAGE_OPTEE_DARKNETZ

config BR2_PACKAGE_OPTEE_DARKNETZ_SITE
	string "OP-TEE darknetz path"
	default ""
	help
	  The path to the source directory of OP-TEE darknetz

config BR2_PACKAGE_OPTEE_DARKNETZ_SDK
	string "OPTEE darknetz path"
	default ""
	help
	  some help

config BR2_PACKAGE_OPTEE_DARKNETZ_CROSS_COMPILE
	string "OPTEE cross compiler"
	default ""
	help
	  some help

endif
```

## build/br-ext/package/optee_get_crl/Config.in
```kconfig
config BR2_PACKAGE_OPTEE_GET_CRL
	bool "optee_get_crl"
	help
	  optee_get_crl project

if BR2_PACKAGE_OPTEE_GET_CRL

config BR2_PACKAGE_OPTEE_GET_CRL_SITE
	string "OP-TEE get_crl path"
	default ""
	help
	  The path to the source directory of OP-TEE get_crl

config BR2_PACKAGE_OPTEE_GET_CRL_SDK
	string "OPTEE SDK path"
	default ""
	help
	  some help

config BR2_PACKAGE_OPTEE_GET_CRL_CROSS_COMPILE
	string "OPTEE cross compiler"
	default ""
	help
	  some help

endif
```

## build/br-ext/package/optee_pic_server/Config.in
```kconfig
config BR2_PACKAGE_OPTEE_PIC_SERVER
	bool "optee_pic_server"
	help
	  optee_pic_server project

if BR2_PACKAGE_OPTEE_PIC_SERVER

config BR2_PACKAGE_OPTEE_PIC_SERVER_SITE
	string "OP-TEE pic_server path"
	default ""
	help
	  The path to the source directory of OP-TEE pic_server

config BR2_PACKAGE_OPTEE_PIC_SERVER_SDK
	string "OPTEE SDK path"
	default ""
	help
	  some help

config BR2_PACKAGE_OPTEE_PIC_SERVER_CROSS_COMPILE
	string "OPTEE cross compiler"
	default ""
	help
	  some help

endif
```

## buildroot/package/python3-pycryptodomex/Config.in
```kconfig
config BR2_PACKAGE_PYTHON3_PYCRYPTODOMEX
	bool "python3-pycryptodomex"
	help
	  Cryptographic library for Python 3.

	  http://www.pycryptodome.org
```
